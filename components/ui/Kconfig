## components/ui/Kconfig
```kconfig
menu "Keyling UI"

    menu "Apps"
        comment "Settings is always built: pairing and factory reset are there."

        config UI_APP_JIGGLER
            bool "Jiggler (moves the mouse to keep the computer awake)"
            default y

        config UI_APP_PROFILES
            bool "Profiles (switch, set up and erase Main and Phantom)"
            default y
            help
                Without it, profiles can still be used from the phone.

        config UI_APP_DRIVE
            bool "Drive (USB drive in place of the smartcard, a test for now)"
            default n
            help
                Shows a read-only drive with INFO.TXT while open; the smartcard is away meanwhile
                and comes back when the app is left or the computer ejects the drive.

        config UI_APP_EXAMPLE
            bool "Template app"
            default n
            help
                Adds ui_app_example.c to the launcher: every kind of menu option, doing nothing.
                It is the starting point for new apps.
    endmenu

    config UI_THEME_EXAMPLE
        bool "Example theme (Quiet)"
        default n
        help
            Adds ui_theme_example.c to the themes in Settings. It is the starting point for new
            themes: copy it, rename the theme, and add it to s_themes in ui.c.

endmenu
```

## components/usb_hid/Kconfig
```kconfig
menu "USB HID"

    config USB_HID_TINYUSB
        bool "Composite TinyUSB device (HID keyboard/mouse/consumer + CDC console)"
        default n
        help
            When disabled, HID reports are written to the log and the USB port stays
            on the built-in USB-Serial-JTAG.

endmenu
```

## sdkconfig.defaults
```kconfig
CONFIG_IDF_TARGET="esp32s3"

# Flash: 16MB QIO, no PSRAM
CONFIG_ESPTOOLPY_FLASHSIZE_16MB=y
CONFIG_ESPTOOLPY_FLASHMODE_QIO=y
CONFIG_ESPTOOLPY_FLASHFREQ_80M=y
CONFIG_PARTITION_TABLE_CUSTOM=y
CONFIG_PARTITION_TABLE_CUSTOM_FILENAME="partitions.csv"
CONFIG_BOOTLOADER_APP_ROLLBACK_ENABLE=y
CONFIG_ESP_COREDUMP_ENABLE_TO_FLASH=y
CONFIG_COMPILER_STACK_CHECK_MODE_STRONG=y

CONFIG_ESP_DEFAULT_CPU_FREQ_MHZ_240=y
CONFIG_FREERTOS_HZ=1000

CONFIG_ESP_CONSOLE_USB_SERIAL_JTAG=y

CONFIG_LV_COLOR_DEPTH_16=y
CONFIG_LV_MEM_SIZE_KILOBYTES=32
CONFIG_LV_FONT_MONTSERRAT_12=y
CONFIG_LV_FONT_MONTSERRAT_14=y
CONFIG_LV_DEFAULT_FONT_MONTSERRAT_12=y
CONFIG_LV_FONT_MONTSERRAT_24=y

CONFIG_BT_ENABLED=y
CONFIG_BT_NIMBLE_ENABLED=y
CONFIG_BT_NIMBLE_ROLE_CENTRAL=n
CONFIG_BT_NIMBLE_ROLE_OBSERVER=n
CONFIG_BT_NIMBLE_MAX_CONNECTIONS=1
CONFIG_BT_NIMBLE_NVS_PERSIST=y
CONFIG_BT_NIMBLE_SM_SC=y
CONFIG_BT_NIMBLE_SM_LEGACY=n
CONFIG_BT_NIMBLE_ATT_PREFERRED_MTU=517
CONFIG_BT_NIMBLE_LOG_LEVEL_WARNING=y
```
